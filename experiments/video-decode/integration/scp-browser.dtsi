// SPDX-License-Identifier: (GPL-2.0 OR MIT)
/* Optional boot-time reservation; never apply to an already-running kernel. */
/ {
 reserved-memory {
  scp_video_reserved: memory@50000000 {
   compatible = "shared-dma-pool";
   reg = <0 0x50000000 0 0x800000>;
   no-map;
  };
 };
};
&scp {
 memory-region = <&scp_video_reserved>;
 firmware-name = "mediatek/mt8183/scp-trona-h264.img";
 status = "okay";
};
